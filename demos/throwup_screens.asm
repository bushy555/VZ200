 ;
 ; BY BOB KITCH Screen movers.
 ; 25/APR./89
 ;
 ;  Trying to get astro boy (one screen graphic) to swipe - or to do anything.
 ; so far, a fail.


	ORG	$8000


 ;SCREEN 0 - SPLAT.
 ;SCREEN 1 - OPEN-UP.
 ;SCREEN 2 - ROLL DOWN.
 ;SCREEN 3 - PUSH DOWN.
 ;SCREEN 4 - ROLL UP.
 ;SCREEN 5 - PUSH UP.
 ;SCREEN 6 - 4 BAR ROLL DOWN.
 ;SCREEN 7 - L TO R SWEEP.
 ;SCREEN 8 - R TO L SWEEP.




 VRAM EQU 7000H		;START OF VIDEO SCREEN.
 SSCN EQU 0B200H	;START OF SCREEN BUFFER.
 SZSC EQU 0800H		;SIZE OF SCREEN.
 HSZC EQU 0400H		;HALF SIZE SCREEN.
 ESCN EQU SSCN+SZSC	;END OF SCREEN BUFFER+1.
 LLEN EQU 20H		;LINE LENGTH IN BYTES. 	(32 decimal)
 NLIN EQU 40H		;NUMBER OF LINES.	(64 decimal)
 BIG EQU 0FFFFH+1	;EQ. TO 65536D.
 ZERO EQU 00H		;ZERO FOR OFFSETS.
 SBF1 EQU 0C000H	;START OF PICTURE BUFFERS.
 SBF2 EQU SBF1+SZSC
 SBF3 EQU SBF2+SZSC
 SBF4 EQU SBF3+SZSC
 SBF5 EQU SBF4+SZSC
 SBF6 EQU SBF5+SZSC
 SBF7 EQU SBF6+SZSC
 SBF8 EQU SBF7+SZSC
 DLAY EQU 4038H		;DELAY ROUTINE IN DOS.
 DURD EQU 12H		;DELAY DURATION IN MSEC.
 TURN EQU 0C9H		;OPCODE FOR RETURN.
 JMP EQU 0C3H		;OPCODE FOR JUMP.
 IVEC EQU 787DH		;3 BYTE INTERRUPT VECTOR.


	ld	a, 8
	ld	($6800), a


	ld	HL, astro	; Load Astro into Buffer #1 (at $C000)
	ld	de, SBF1
	ld	bc, 2048
	ldir

	ld	HL, nyan	; Load NYAN  into Buffer #2 (at $C800)
	ld	de, SBF2
	ld	bc, 2048
	ldir

	ld	HL, loderunner	; Load LR into Buffer #3 (at $C000)
	ld	de, SBF3
	ld	bc, 2048
	ldir

	ld	HL, car		; Load CAR  into Buffer #4 (at $C800)
	ld	de, SBF4
	ld	bc, 2048
	ldir

	ld	HL, astro	; Load Astro into Buffer #5 (at $C000)
	ld	de, SBF5
	ld	bc, 2048
	ldir

	ld	HL, nyan	; Load NYAN  into Buffer #2 (at $C800)
	ld	de, SBF6
	ld	bc, 2048
	ldir

	ld	HL, loderunner	; Load LR into Buffer #3 (at $C000)
	ld	de, SBF7
	ld	bc, 2048
	ldir

	ld	HL, car		; Load CAR  into Buffer #4 (at $C800)
	ld	de, SBF8
	ld	bc, 2048
	ldir




STRT: 	DI


here1:	
	call	SC0
 	call 	SC1	; SCREEN 1 - OPEN-UP.
 	call	SC2	; SCREEN 2 - ROLL DOWN.
 	call	SC3	; SCREEN 3 - PUSH DOWN.
 	call	SC4	; SCREEN 4 - ROLL UP.
 	call 	SC5	; SCREEN 5 - PUSH UP.
 	call 	SC6	; SCREEN 6 - 4 BAR ROLL DOWN.
 	call 	SC7	; SCREEN 7 - L TO R SWEEP.
 	call 	SC8	; SCREEN 8 - R TO L SWEEP.

	jp	here1






 ;SCREEN 0 - SPLAT.
SC0:
 	push	hl
	push	de
	push	af
	push	bc
 	LD 	HL,SBF1
 	LD 	DE,SSCN
 	LD 	BC,SZSC
 	LDIR
 	CALL 	DPLY
	pop	bc
	pop	af
	pop	de
	pop	hl
 	RET







 ;SCREEN 1 - OPEN-UP.
SC1 	push	hl
	push	de
	push	af
	push	bc

 	PUSH 	IX
 	PUSH 	IY
 	LD 	HL,SBF1+HSZC
 	LD 	DE,SSCN+HSZC
 	PUSH 	HL
 	POP 	IX
 	PUSH 	DE
 	POP 	IY
 	DEC 	HL
 	DEC 	DE
 	LD 	B,20H
NLN1 	PUSH 	BC
 	LD 	BC,LLEN
 	LDDR
 	PUSH 	HL
 	PUSH 	DE
 	PUSH 	IX
 	POP 	HL
 	PUSH 	IY
 	POP 	DE
 	LD 	BC,LLEN
 	LDIR
 	PUSH 	HL
 	POP 	IX
 	PUSH 	DE
 	POP 	IY
 	CALL 	DPLY
 	POP 	DE
 	POP 	HL
 	POP 	BC
 	DJNZ 	NLN1
 	POP 	IY
 	POP 	IX

	pop	bc
	pop	af
	pop	de
	pop	hl

 	RET


 ;SCREEN 2 - ROLL DOWN.
SC2 	
 	push	hl
	push	de
	push	af
	push	bc

 	LD 	HL,SBF2
 	LD 	DE,SSCN
 	LD 	B,NLIN
NLN2 	PUSH 	BC
 	LD 	BC,LLEN
 	LDIR
 	CALL 	DPLY
 	POP 	BC
 	DJNZ 	NLN2
	pop	bc
	pop	af
	pop	de
	pop	hl

 	RET


 ;SCREEN 3 PUSH DOWN.
SC3 	 	
	push	hl
	push	de
	push	af
	push	bc

	LD 	HL,SBF3-1
 	LD 	B,NLIN+1
NSN3 	PUSH 	BC
 	LD 	DE,ESCN-1
 	LD 	BC,SZSC
 	LDDR
 	LD 	BC,SZSC-LLEN
 	ADD 	HL,BC
 	CALL 	DPLY
 	POP 	BC
 	DJNZ 	NSN3
	pop	bc
	pop	af
	pop	de
	pop	hl

 	RET


 ;SCREEN 4 - ROLL UP.
SC4 	
 	push	hl
	push	de
	push	af
	push	bc
 	LD 	HL,SBF4-1
 	LD 	DE,ESCN-1
 	LD 	B,NLIN
NLN4 	PUSH 	BC
 	LD 	BC,LLEN
 	LDDR
 	CALL 	DPLY
 	POP 	BC
 	DJNZ 	NLN4
 	pop	bc
	pop	af
	pop	de
	pop	hl

 	RET



 ;SCREEN 5 - PUSH UP.
SC5 	push	hl
	push	de
	push	af
	push	bc
	LD 	HL,SBF5-1
 	LD 	B,NLIN+1
NSN5 	PUSH 	BC
 	LD 	DE,ESCN-1
 	LD 	BC,SZSC
 	LDDR
 	LD 	BC,SZSC+LLEN
 	ADD 	HL,BC
 	CALL 	DPLY
 	POP 	BC
 	DJNZ 	NSN5
	pop	bc
	pop	af
	pop	de
	pop	hl

 	RET



 ;SCREEN 6 - 4 BAR ROLL DOWN.
SC6 	
 	push	hl
	push	de
	push	af
	push	bc
 	LD 	HL,SBF6
 	LD 	DE,SSCN
 	LD 	B,10H
 	NBR6 	PUSH BC
 	LD 	B,4H
NLN6 	PUSH 	BC
 	LD 	BC,LLEN
 	LDIR
 	LD 	BC,200H-LLEN
 	ADD 	HL,BC
 	EX 	DE,HL
 	ADD 	HL,BC
 	EX 	DE,HL
 	POP 	BC
 	DJNZ 	NLN6
 	LD 	BC,SZSC-LLEN
 	OR 	A
 	SBC 	HL,BC
 	EX 	DE,HL
 	OR 	A
 	SBC 	HL,BC
 	EX 	DE,HL
 	CALL 	DPLY
 	POP 	BC
 	DJNZ 	NBR6
	pop	bc
	pop	af
	pop	de
	pop	hl

 	RET


 ;SCREEN 7 - L TO R SWEEP.
SC7 	
 	push	hl
	push	de
	push	af
	push	bc

 	PUSH 	IX
 	PUSH 	IY
 	LD 	IX,SBF7
 	LD 	IY,SSCN
 	LD 	B, LLEN
NCL7 	PUSH 	BC
 	LD 	H,0FFH
 	LD 	B, 4
NPX7 	PUSH 	BC
 	SRL 	H
 	SRL 	H
 	LD 	A,H
 	CPL
 	LD 	L,A
 	LD 	B,NLIN
NLN7 	LD 	A,(IX+ZERO)
 	AND 	L
 	LD 	D,A
 	LD 	A,(IY+ZERO)
 	AND 	H
 	OR 	D
 	LD 	(IY+ZERO),A
 	LD 	DE,LLEN
 	ADD 	IX,DE
 	ADD 	IY,DE
 	DJNZ 	NLN7
 	CALL 	DPLY
 	LD 	DE,BIG-SZSC
 	ADD 	IX,DE
 	ADD 	IY,DE
 	POP 	BC
 	DJNZ 	NPX7
 	INC 	IX
 	INC 	IY
 	POP 	BC
 	DJNZ 	NCL7
 	POP IY
 	POP IX
	pop	bc
	pop	af
	pop	de
	pop	hl

 	RET


 ;SCREEN 8 - R TO L SWEEP.
SC8 	
 	push	hl
	push	de
	push	af
	push	bc
 	PUSH 	IX
 	PUSH 	IY
 	LD 	IX,SBF8+1FH
 	LD 	IY,SSCN+1FH
 	LD 	B,LLEN
NCL8 	PUSH 	BC
 	LD 	H,0FFH
 	LD 	B,4
NPX8 	PUSH 	BC
 	SLA 	H
 	SLA 	H
 	LD 	A,H
 	CPL
 	LD 	L,A
 	LD 	B,NLIN
NLN8 	LD 	A, (IY+ZERO)
 	AND 	L
 	LD 	D,A
 	LD 	A,(IY+ZERO)
 	AND 	H
 	OR 	D
 	LD 	(IY+ZERO),A
 	LD 	DE,LLEN
 	ADD 	IX,DE
 	ADD 	IY,DE
 	DJNZ 	NLN8
 	CALL 	DPLY
 	LD 	DE,BIG-SZSC
 	ADD 	IX,DE
 	ADD 	IY,DE
 	POP 	BC
 	DJNZ 	NPX8
 	DEC 	IX
 	DEC 	IY
 	POP 	BC
 	DJNZ 	NCL8
 	POP 	IY
 	POP 	IX
	pop	bc
	pop	af
	pop	de
	pop	hl

 	RET



 ;MOVE SCREEN BUFFER TO VRAM.
MTOP 	LD 	HL,SSCN
 	LD 	DE,VRAM
 	LD	BC,HSZC
 	LDIR
 	DI
 	LD 	BC,MBOT
 	LD 	(IVEC+1),BC
 	EI
 	RET
MBOT	LD 	HL,SSCN+HSZC
 	LD 	DE,VRAM+HSZC
 	LD 	BC,HSZC
 	LDIR				 ;MOVE BOTTOM HALF SCRN. BUF.
 	DI
 	LD 	A,TURN
 	LD 	(IVEC),A			;SET INTERRUPT VECTOR TO RET AS BOTH HALVES ARE MOVED.
 	EI
 	RET



 ;INTERRUPT DRIVEN DISPLAY ROUTINE. A PAUSE IS DONE
 ;SO THAT THE TOP AND BOTTOM HALVES OF THE SCREEN CAN BE
 ;MOVED FROM THE SCREEN BUFFER TO VRAM.
 ;NB. BC REG. IS CHANGED BY THIS SUBROUTINE.
DPLY 	LD 	A, JMP
 	LD 	BC,MTOP
 	LD 	(IVEC+1),BC
 	LD 	(IVEC),A
 	EI
 	LD 	BC,DURD				 ;DELAY MSEC.
 	CALL 	DLAY
 	DI
 	RET				 ;RETURN TO MOVE ROUTINES.
 


astro:
defb 0x00,0x00,0x00,0x00,0x00,0x00,0x00,0x00,0x00,0x00,0x00,0x00,0x00,0x00,0x00,0x00
defb 0x00,0x00,0x00,0x00,0x00,0x00,0x03,0x30,0x00,0x00,0x00,0x00,0x00,0x00,0x00,0x00
defb 0x00,0x00,0x00,0x00,0x00,0x00,0x00,0x00,0x00,0x00,0x00,0x00,0x00,0x00,0x00,0x00
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defb 0x00,0x00,0x00,0x00,0x00,0x00,0x00,0x00,0x00,0x00,0x00,0x00,0x00,0x00,0x00,0x00

nyan:
defb 0xAA,0xAA,0xAA,0xAA,0xAA,0xAA,0xAA,0xAA,0xAA,0xAA,0xAA,0xAA,0xAA,0xAA,0xAA,0xAA
defb 0xAA,0xAA,0xAA,0xAA,0xAA,0xAA,0xAA,0xAA,0xAA,0xAA,0xAA,0xAA,0xAA,0xAA,0xAA,0xAA
defb 0xAA,0xAA,0xAA,0xAA,0xAA,0xAA,0xAA,0xAA,0xAA,0xAA,0xAA,0xAA,0xAA,0xAA,0xAA,0xAA
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defb 0xAA,0xAA,0xAA,0xAA,0xAA,0xAA,0xAA,0xAA,0xAA,0xAA,0xAA,0xAA,0xAA,0xAA,0xAA,0xAA

loderunner:
defb $0FF,$0FF,$0FF,$0FF,$0FF,$0FF,$0FF,$0FF,$0FF,$0FF,$0FF,$0FF,$079,$0E7,$09E,$079
defb $0E7,$09E,$079,$0E7,$09E,$079,$0E7,$09E,$079,$0E7,$08E,$038,$0E3,$08E,$038,$0E3
defb $0FF,$0FF,$0FF,$0FF,$0FF,$0FF,$0FF,$0FF,$0FF,$0FF,$0FF,$0FF,$0DE,$079,$0E7,$09E
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defb $0FF,$0FF,$0FF,$0FF,$0FF,$0FF,$0FF,$0FF,$0FF,$0FF,$0FF,$0FF,$0FF,$0FF,$0FF,$0FF

car:
defb $000,$000,$000,$000,$000,$000,$000,$001,$005,$050,$000,$000,$000,$000,$000,$000
defb $002,$0AA,$0AA,$0AA,$0AA,$0AA,$0AA,$0AA,$0AA,$0AA,$0AA,$0AA,$0AA,$0AA,$0AA,$0AA
defb $000,$000,$000,$000,$000,$000,$000,$000,$000,$010,$000,$000,$000,$000,$000,$000
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defb $000,$000,$000,$000,$000,$000,$000,$000,$000,$000,$000,$000,$000,$000,$000,$000

end
