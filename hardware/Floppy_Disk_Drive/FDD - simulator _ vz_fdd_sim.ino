//yields nigh on 32.2usec clock bit interval
#define cell_time 515

//yields pulse of 1usec
#define pulse_time 14

//yields nigh on 13usec from leading edge of clock to leading edge of bit
#define bit_delay 185

byte fakefm[] = {

// gap/sync & idam
0x80,0x80,0x80,0x80,0x80,0x80,0x80,0x00,0xfe,0xe7,0x18,0xc3,
//

//track, sector, checksum
0x00,0x00,0x00,
//

//sync & dam
0x80,0x80,0x80,0x80,0x80,0x00,0xc3,0x18,0xe7,0xfe,
//

//sector data
0x42,0x3a,0x47,0x41,0x4d,0x45,0x20,0x20,
0x20,0x20,0x01,0x00,0x00,0x80,0xc8,0x81,
0x00,0x00,0x00,0x00,0x00,0x00,0x00,0x00,
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0x00,0x00,0x00,0x00,0x00,0x00,0x00,0x00,

//checksum
0xe0,0x03,

//additional pad bytes, not part of vz track specification
0x00,0x00  
//
};

int elements = sizeof(fakefm) / sizeof(byte);
int fmptr = 0;
byte rotator = 8;
byte currentbyte = 0;

void setup() {
  pinMode(LED_BUILTIN, OUTPUT);
  currentbyte = fakefm[0];
  
  cli();
  TCCR1A = 0;
  TCCR1B = 0;
  TCNT1  = 0;
  OCR1A = cell_time;
  TCCR1B |= (1 << WGM12);
  TCCR1B |= (1 << CS20);
  TIMSK1 |= (1 << OCIE1A);
  sei();  
}

ISR(TIMER1_COMPA_vect) {
  bitSet(PORTB, 5);
  __builtin_avr_delay_cycles (pulse_time);
  bitClear(PORTB, 5);
  
  if (currentbyte & 0x80) {
    __builtin_avr_delay_cycles (bit_delay);
    bitSet(PORTB, 5);
    __builtin_avr_delay_cycles (pulse_time);
    bitClear(PORTB, 5);
  }
  
  currentbyte <<= 1;
  
  rotator --;
  if (! rotator) {
    rotator = 8;
    fmptr ++;
    if (fmptr > elements) {
      fmptr = 0;
    }
    currentbyte = fakefm[fmptr];
  }  
}

void loop() {
  while (true) {  //avoid what ever has been packed into the loop routine
  }
}

