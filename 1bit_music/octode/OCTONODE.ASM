#define TI82				; select target platform here
;#define TI83


#define defb .db
#define defw .dw
#define db  .db
#define dw  .dw
#define end .end
#define org .org
#define DEFB .db
#define DEFW .dw
#define DB  .db
#define DW  .dw
#define END .end
#define ORG .org
#define equ .equ
#define EQU .equ

	ORG	$8000

port1	equ 16
port2	equ 0



;Octode beeper music engine by Shiru (shiru@mail.ru) 02'11
;Eight channels of tone
;One channel of interrupting drums, no ROM data required
;Feel free to do whatever you want with the code, it is PD
;Modified for Z80 TI calculators by utz


begin

cls: 	call 	$01c9		; VZ ROM CLS
	ld 	hl, MSG1	; Print MENU
	call 	$28a7		; VZ ROM Print string.


	di	
	ld hl,musicData
	call play
	ei

	ret

OPxNOP	EQU $00
OPxRRA	EQU $1f
OPxSCF	EQU $37
OPxORC	EQU $b1


.MODULE octode

play
	di
	ld e,(hl)
	inc hl
	ld d,(hl)
	inc hl
	ld (xspeed),de

	ld e,(hl)
	inc hl
	ld d,(hl)
	inc hl
	ld (xptr),de

	ld e,(hl)
	inc hl
	ld d,(hl)
	ld (xloop),de

readNotes
xptr .EQU $+1
	ld hl,0
	ld a,(hl)
	inc hl
	cp 240
	jr c,xnoLoop
	cp 255
	jr nz,xdrum
xloop .EQU $+1
	ld hl,0
	ld (xptr),hl
	jp xcheckKey

xdrum
	ld (xptr),hl
	ld b,8
	ld hl,xdrum2
	ld (hl),OPxNOP
	inc hl
	djnz $-3
	sub 240
	jr z,xdrum0
	ld b,a
	ld hl,xdrum2
	ld (hl),OPxRRA
	inc hl
	djnz $-3
xdrum0
	ld bc,100*256
xdrum1
	ld a,c
xdrum2 .EQU $
	rra
	rra
	rra
	rra
	rra
	rra
	rra
	rra
	xor b
	and port1
	
	push af		;+11
	bit 4,a		;+8
	jr nz, $+6	;+7/12
	ld a,$fc	;+7
	jr $+6		;+12 
	nop			;+4
	nop			;+4
	ld a,port2	;f
	and 33
	ld        (26624),a	;11
	ld        (26624),a	;+11
	ld        (26624),a	;+11
	push hl		;+11
	nop			;+4
	nop			;+4
	pop hl		;+11
	pop af		;+10	+55/56 +41

	bit 0,(ix)
	inc c
	inc c
	xor a
			
	push af		;+11
	bit 4,a		;+8
	jr nz, $+6	;+7/12
	ld a,$fc	;+7
	jr $+6		;+12 
	nop			;+4
	nop			;+4
	ld a, port2
	and 33
	ld        (26624),a	;11
	ld        (26624),a	;+11
	ld        (26624),a	;+11
	push hl		;+11
	nop			;+4
	nop			;+4
	pop hl		;+11
	pop af		;+10	+55/56 +41

	djnz xdrum1

	ld hl,(xptr)

xnoLoop
	ld b,(hl)
	inc hl

	ld c,OPxSCF

	xor a
	rr b
	jr nc,xch1
	ld a,(hl)
	inc hl
	ld (xfrq0),a
	ld a,c
xch1
	ld (xoff0),a

	xor a
	rr b
	jr nc,xch2
	ld a,(hl)
	inc hl
	ld (xfrq1),a
	ld a,c
xch2
	ld (xoff1),a

	xor a
	rr b
	jr nc,xch3
	ld a,(hl)
	inc hl
	ld (xfrq2),a
	ld a,c
xch3
	ld (xoff2),a

	xor a
	rr b
	jr nc,xch4
	ld a,(hl)
	inc hl
	ld (xfrq3),a
	ld a,c
xch4
	ld (xoff3),a

	xor a
	rr b
	jr nc,xch5
	ld a,(hl)
	inc hl
	ld (xfrq4),a
	ld a,c
xch5
	ld (xoff4),a

	xor a
	rr b
	jr nc,xch6
	ld a,(hl)
	inc hl
	ld (xfrq5),a
	ld a,c
xch6
	ld (xoff5),a

	xor a
	rr b
	jr nc,xch7
	ld a,(hl)
	inc hl
	ld (xfrq6),a
	ld a,c
xch7
	ld (xoff6),a

	xor a
	rr b
	jr nc,xchDone
	ld a,(hl)
	inc hl
	ld (xfrq7),a
	ld a,c
xchDone
	ld (xoff7),a

	ld (xptr),hl

xprevBC .EQU $+1
	ld bc,0
xspeed .EQU $+1
	ld hl,0
	and a

soundLoop
	xor a		;4

	dec b		;4
	jr z,xla0	;7/12
	nop			;4
	jr xlb0		;12
xla0
xfrq0 .EQU $+1
	ld b,0		;7
xoff0 .EQU $
	scf			;4
xlb0
	dec c		;4
	jr z,xla1	;7/12
	nop			;4
	jr xlb1		;12
xla1
xfrq1 .EQU $+1
	ld c,0		;7
xoff1 .EQU $
	scf			;4
xlb1
	dec d		;4
	jr z,xla2	;7/12
	nop			;4
	jr xlb2		;12
xla2
xfrq2 .EQU $+1
	ld d,0		;7
xoff2 .EQU $
	scf			;4
xlb2
	dec e		;4
	jr z,xla3	;7/12
	nop			;4
	jr xlb3		;12
xla3
xfrq3 .EQU $+1
	ld e,0		;7
xoff3 .EQU $
	scf			;4
xlb3
	exx			;4
	
	push af		;+11
	bit 4,a		;+8
	jr nz, $+6	;+7/12
	ld a,$fc	;+7
	jr $+6		;+12 
	nop			;+4
	nop			;+4
	ld a, port2
	and 33
	ld        (26624),a	;11
	ld        (26624),a	;+11
	ld        (26624),a	;+11
	push hl		;+11
	nop			;+4
	nop			;+4
	pop hl		;+11
	pop af		;+10	+55/56 +41
	
	dec b		;4
	jr z,xla4	;7/12
	nop			;4
	jr xlb4		;12
xla4
xfrq4 .EQU $+1
	ld b,0		;7
xoff4 .EQU $
	scf			;4
xlb4
	dec c		;4
	jr z,xla5	;7/12
	nop			;4
	jr xlb5		;12
xla5
xfrq5 .EQU $+1
	ld c,0		;7
xoff5 .EQU $
	scf			;4
xlb5
	dec d		;4
	jr z,xla6	;7/12
	nop			;4
	jr xlb6		;12
xla6
xfrq6 .EQU $+1
	ld d,0		;7
xoff6 .EQU $
	scf			;4
xlb6
	dec e		;4
	jr z,xla7	;7/12
	nop			;4
	jr xlb7		;12
xla7
xfrq7 .EQU $+1
	ld e,0		;7
xoff7 .EQU $
	scf			;4
xlb7
	exx			;4
	sbc a,a		;4
	and port1		;7
	
	push af		;+11
	bit 4,a		;+8
	jr nz, $+6	;+7/12
	ld a,$fc	;+7
	jr $+6		;+12 
	nop			;+4
	nop			;+4
	ld a, port2
	and 33
	ld        (26624),a	;11
	ld        (26624),a	;+11
	ld        (26624),a	;+11
	push hl		;+11
	nop			;+4
	nop			;+4
	pop hl		;+11
	pop af		;+10	+55/56 +41
	
	dec l		;4
	jp nz,soundLoop	;10 = 275t
	dec h		;4
	jp nz,soundLoop	;10

	ld (xprevBC),bc

	xor a
	
	push af		;+11
	bit 4,a		;+8
	jr nz, $+6	;+7/12
	ld a,$fc	;+7
	jr $+6		;+12 
	nop			;+4
	nop			;+4
	ld a, port2
	and 33
	ld        (26624),a	;11
	ld        (26624),a	;+11
	ld        (26624),a	;+11
	push hl		;+11
	nop			;+4
	nop			;+4
	pop hl		;+11
	pop af		;+10	+55/56 +41


xcheckKey
	xor a
	ld c,a
;	ld a,%10111111				;+ new keyhandler
;	out (1),a
;	in a,(1)				;read keyboard
;	cpl
;	bit 6,a
;	jp z,readNotes

	jp readNotes

stopPlayer
	exx
	ei
	ret

MSG1	db " VZ OCTODE 8 CHANNEL",$0d
	db "  CHIP TUNE PLAYER",$0d, $0d
MSG2	db "PLAYING:OCTODE THEME",00


	

musicData

	dw $0200
	dw patstart
	dw patloop
patstart
	db $00,$78            ,$56,$ac,$ad,$ab    
	db $00,$00                                
	db $00,$78            ,$56,$ac,$ad,$ab    
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	db $00,$03,$33,$2b                        
patloop
	db $f1,$ff,$39,$0c,$24,$56,$55,$ad,$ab,$ad
	db $00,$05,$30    ,$24                    
	db $00,$ff,$20,$39,$24,$56,$55,$ad,$ab,$ad
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	db $ff



#ifdef TI83
.END
	dw $0000
.END
#endif

end
