
	org $8000

	;test code

begin

	ld hl,music_data
	call play
	ret
	
	
	
	;engine code

;squat by Shiru, 06'17
;Squeeker like, just without the output value table
;4 channels of tone with different duty cycle
;sample drums, non-interrupting
;customizeable noise percussion, interrupting


;music data is all 16-bit words, first control then a few optional ones

;control word is PSSSSSSS DDDN4321, where P equ percussion,S equ speed, D equ drum, N equ noise mode, 4321 equ channels
;D triggers non-interruping sample drum
;P trigger
;if 1, channel 1 freq follows
;if 2, channel 2 freq follows
;if 3, channel 3 freq follows
;if 4, channel 4 freq follows
;if N, channel 4 mode follows, it is either $0000 (normal) or $04cb (noise)
;if P, percussion follows, LSB equ volume, MSB equ pitch



RLC_H equ $04cb			;to enable noise mode
NOP_2 equ $0000			;to disable noise mode
RLC_HL equ $06cb		;to enable sample reading
ADD_IX_IX equ $29dd		;to disable sample reading


play

	di
	
	ld e,(hl)
	inc hl
	ld d,(hl)
	inc hl
	ld (loop_ptr),de
	
	ld (pattern_ptr),hl
	
	ld hl,ADD_IX_IX
	ld (sample_read),hl
	ld hl,NOP_2					;normal mode
	ld (noise_mode),hl
	
	ld ix,0						;needs to be 0 to skip sample reading

	ld c,0
	exx
	ld de,$0808					;sample bit counter and reload value

play_loop

pattern_ptr equ $+1
	ld sp,0
	
return_loop

	pop bc						;control word
								;B equ duration of the row (0 equ loop)
								;C equ flags DDDN4321 (Drum, Noise, 1-4 channel update)
	ld a,b
	or a
	jp nz,no_loop
	
loop_ptr equ $+1
	ld sp,0
	
	jp return_loop
	
no_loop

	ld a,c
	
	rra
	jr nc,skip_note_0
	
	pop hl
	ld (ch0_add),hl
	
skip_note_0

	rra
	jr nc,skip_note_1

	pop hl
	ld (ch1_add),hl
	
skip_note_1

	rra
	jr nc,skip_note_2
	
	pop hl
	ld (ch2_add),hl
	
skip_note_2

	rra
	jr nc,skip_note_3
	
	pop hl
	ld (ch3_add),hl
	
skip_note_3

	rra
	jr nc,skip_mode_change
	
	pop hl						;nop:nop or rlc h
	ld (noise_mode),hl

skip_mode_change

	and 7
	jp z,skip_drum
	
	ld hl,sample_list-2
	add a,a
	add a,l
	ld l,a
	ld a,(hl)
	inc l
	ld h,(hl)
	ld l,a
	ld (sample_ptr),hl
	ld hl,RLC_HL
	ld (sample_read),hl

skip_drum

	bit 7,b						;check percussion flag
	jp z,skip_percussion

	res 7,b						;clear percussion flag
	dec b						;compensate speed

	ld (noise_bc),bc
	ld (noise_de),de

	pop hl						;read percussion parameters

	ld a,l						;noise volume
	ld (noise_volume),a
	ld b,h						;noise pitch
	ld c,h
	ld de,$2174					;utz's rand seed			
	exx
	ld bc,811					;noise duration, takes as long as inner sound loop

noise_loop

	exx							;4
	dec c						;4
	jr nz,noise_skip			;7/12
	ld c,b						;4
	add hl,de					;11
	rlc h						;8		utz's noise generator idea
	inc d						;4		improves randomness
	jp noise_next				;10
	
noise_skip

	jr $+2						;12
	jr $+2						;12
	nop							;4
	nop							;4
	
noise_next

	ld a,h						;4
	
noise_volume equ $+1
	cp $80						;7
	sbc a,a						;4
;	out ($fe),a					;11
	and 32
	ld (26624), a

	exx							;4

	dec bc						;6
	ld a,b						;4
	or c						;4
	jp nz,noise_loop			;10 equ 106t

	exx

noise_bc equ $+1
	ld bc,0
noise_de equ $+1
	ld de,0



skip_percussion

	ld (pattern_ptr),sp

sample_ptr equ $+1
	ld hl,0

	ld c,0						;internal loop runs 256 times

sound_loop

sample_read equ $
	rlc (hl)					;15 	rotate sample bits in place, rl (hl) or add ix,ix (dummy operation)
	sbc a,a						;4		sbc a,a to make bit into 0 or 255, or xor a to keep it 0

	dec e						;4--+	count bits
	jp z,sample_cycle			;10 |
	jp sample_next				;10

sample_cycle

	ld e,d						;4	|	reload counter
	inc hl						;6--+	advance pointer --24t

sample_next

	exx							;4		squeeker type unrolled code
	ld b,a						;4		sample mask
	xor a						;4
	
	ld sp,sound_list			;10
		
	pop de						;10		ch0_acc
	pop hl						;10		ch0_add
	add hl,de					;11
	rla							;4
	ld (ch0_acc),hl				;16
						
	pop de						;10		ch1_acc
	pop hl						;10		ch1_add
	add hl,de					;11
	rla							;4
	ld (ch1_acc),hl				;16
	
	pop de						;10		ch2_acc
	pop hl						;10		ch2_add
	add hl,de					;11
	rla							;4
	ld (ch2_acc),hl				;16

	pop de						;10		ch3_acc
	pop hl						;10		ch3_add
	add hl,de					;11
	
noise_mode equ $
	ds 2,0						;8		rlc h for noise effects

	rla							;4
	ld (ch3_acc),hl				;16

	add a,c						;4		no table like in Squeeker, channels summed as is, for uneven 'volume'
	add a,$ff					;7
	sbc a,$ff					;7
	ld c,a						;4
	sbc a,a						;4

	or b						;4		mix sample
	
;	out ($fe),a					;11

	and 32
	ld (26624), a

		
	exx							;4

	dec c						;4
	jp nz,sound_loop			;10 equ 336t


	dec hl						;last byte of a 256 byte sample packet is 0 means it was the last packet
	ld a,(hl)
	inc hl
	or a						;check for 0
	jr nz,sample_no_stop

	ld hl,ADD_IX_IX
	ld (sample_read),hl			;disable sample reading

sample_no_stop

	djnz sound_loop

	ld (sample_ptr),hl
	
	jp play_loop
	
	
	

sample_list

	dw sample_1
	dw sample_2
	dw sample_3
	dw sample_4
	dw sample_5
	dw sample_6
	dw sample_7
	
;variables in the sound_list can't be reordered because of stack-based fetching

sound_list

ch0_add		dw 0
ch0_acc		dw 0
ch1_add		dw 0
ch1_acc		dw 0
ch2_add		dw 0
ch2_acc		dw 0
ch3_add		dw 0
ch3_acc		dw 0


;sample data

	

sample_1
	db 4,4,114,125,1,68,0,0,0,0,248,255,255,255,255,255
	db 1,0,0,0,0,0,0,0,0,0,255,255,255,255,255,255
	db 0,0,0,128,255,255,255,255,127,15,1,0,0,0,0,0
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	db 0,0,0,0,0,0,0,0,0,0,0,0,0,0,0,0
sample_2
	db 62,1,144,127,240,2,0,0,248,255,3,0,0,162,255,55
	db 0,0,128,252,127,4,0,0,252,63,6,0,0,64,68,122
	db 91,253,59,1,17,0,0,0,138,4,0,192,195,45,0,0
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	db 0,0,0,0,0,0,0,0,0,0,0,0,0,0,0,0
sample_3
	db 0,7,47,1,0,0,0,2,0,8,0,0,0,0,0,0
	db 0,0,0,0,64,64,0,0,0,0,0,0,0,0,0,0
	db 0,0,0,0,0,0,0,0,0,0,0,0,0,0,0,0
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	db 0,0,0,0,0,0,0,0,0,0,0,0,0,0,0,0
sample_4
sample_5
sample_6
sample_7


;compiled music data

music_data
	dw .loop
.pattern
	dw $21f,$0,$568,$0,$0,NOP_2
	dw $202,$0
	dw $200
	dw $200
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	dw $200
.loop
	dw $7f1f,0,0,0,0,NOP_2
	dw 0
